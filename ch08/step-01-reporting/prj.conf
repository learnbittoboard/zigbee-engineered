## CMakeLists.txt
```
# Chapter 8, Step 1 — Reporting: the endpoint, with a reporting context.
cmake_minimum_required(VERSION 3.20.0)
find_package(Zephyr REQUIRED HINTS $ENV{ZEPHYR_BASE})
project(ch08_reporting)

target_sources(app PRIVATE src/main.c src/ld2410.c)
target_include_directories(app PRIVATE include)
```

## Kconfig
```
# Chapters 7–8 sensor apps — the application Kconfig.
#
# This app defines no product knobs of its own (Chapter 8 adds
# the first); the file exists for the two lines at the bottom.
# Per-module log-level symbols for OUR driver do not appear by
# magic: they exist only where a Kconfig file instantiates
# Zephyr's log-config template for that module name (Chapter 2,
# Step 3 taught this; Chapter 4's driver app did it first). This
# does it for LD2410, creating CONFIG_LD2410_LOG_LEVEL_DBG and
# friends — which is what lets prj.conf aim the driver's log
# level without touching the application module.

module = LD2410
module-str = HLK-LD2410 driver (Chapters 4 + 7)
source "subsys/logging/Kconfig.template.log_config"

source "Kconfig.zephyr"
```

## prj.conf
```kconfig
#
# Chapter 8, Step 1 — reporting.
# Configuration is Chapter 7, Step 2's, unchanged: reporting is a
# declaration (the endpoint header's reporting context), not a
# Kconfig option — and the cadence itself is not configured here
# at all; it arrives over the air from the coordinator.
#

CONFIG_NCS_SAMPLES_DEFAULTS=y

# Serial console (the DK's USB UART) for logs.
CONFIG_UART_INTERRUPT_DRIVEN=y
CONFIG_SERIAL=y
CONFIG_GPIO=y
CONFIG_CONSOLE=y
CONFIG_UART_CONSOLE=y

CONFIG_HEAP_MEM_POOL_SIZE=2048
CONFIG_MAIN_THREAD_PRIORITY=7

# The Zigbee R23 add-on itself, the application utilities, and
# this device's role: ROUTER.
CONFIG_ZIGBEE_ADD_ON=y
CONFIG_ZIGBEE_APP_UTILS=y
CONFIG_ZIGBEE_ROLE_ROUTER=y

# Enable DK LED and Buttons library
CONFIG_DK_LIBRARY=y

# This example requires more workqueue stack
CONFIG_SYSTEM_WORKQUEUE_STACK_SIZE=2048

# --- Chapter 4's driver, riding along ------------------------------
# The LD2410 receive path: interrupt-driven UART into a ring
# buffer, parser thread behind it (src/ld2410.c, unchanged).
CONFIG_RING_BUFFER=y

# The driver's own log module stays at INF: startup and resync
# warnings only. (The symbol exists because this app's Kconfig
# instantiates the log template for the LD2410 module name.)
CONFIG_LD2410_LOG_LEVEL_INF=y

# The `presence` shell command (src/main.c): live reading, driver
# counters, and the attribute the network can read.
CONFIG_SHELL=y
```

## src/main.c
```c
/*
 * Chapter 8, Step 1 — the endpoint learns to REPORT.
 *
 * Application code is Chapter 7, Step 2's, essentially untouched
 * — and that is the step's entire point. The one change lives in
 * include/zb_occupancy_sensor.h: the endpoint declaration now
 * carries a REPORTING CONTEXT (one slot — the Occupancy
 * attribute is the cluster's only reportable attribute). With
 * storage to hold a reporting configuration, the stack can
 * accept a Configure Reporting command from the coordinator and
 * start volunteering the attribute's changes on the configured
 * cadence, instead of waiting to be read.
 *
 * Nothing in this file "sends" a report. publish_occupancy()
 * writes the value with ZB_ZCL_SET_ATTRIBUTE, exactly as in
 * Chapter 7; the stack's reporting engine watches those writes,
 * applies the min/max-interval and reportable-change rules it
 * was configured with, and emits Report Attributes commands on
 * its own schedule. Configuration is the coordinator's job
 * (Chapter 5's `zcl subscribe`); cadence policy lives there too.
 *
 * The pipeline below the endpoint is unchanged on purpose:
 *
 *   LD2410 frame -> driver callback (parser thread)
 *                -> transition filter (state changed?)
 *                -> work item (system workqueue)
 *                -> ZBOSS-scheduled publish_occupancy()
 *                -> ZB_ZCL_SET_ATTRIBUTE (stack context)
 *                -> [reporting engine: on change / on schedule]
 */

#include <zephyr/kernel.h>
#include <zephyr/device.h>
#include <zephyr/devicetree.h>
#include <zephyr/logging/log.h>
#include <zephyr/shell/shell.h>
#include <dk_buttons_and_leds.h>

#include <zboss_api.h>
#include <zigbee/zigbee_error_handler.h>
#include <zigbee/zigbee_app_utils.h>
#include <zb_nrf_platform.h>
#include "zb_occupancy_sensor.h"

#include "ld2410.h"


/* Device endpoint — the same number Chapters 6–7 use throughout. */
#define SENSOR_ENDPOINT                     10

/* Type of power sources available for the device.
 * For possible values see section 3.2.2.2.8 of ZCL specification.
 */
#define SENSOR_INIT_BASIC_POWER_SOURCE      ZB_ZCL_BASIC_POWER_SOURCE_DC_SOURCE

/* LED indicating that device successfully joined Zigbee network. */
#define ZIGBEE_NETWORK_STATE_LED            DK_LED3

/* LED used for device identification. */
#define IDENTIFY_LED                        DK_LED4

/* Button used to enter the Identify mode. */
#define IDENTIFY_MODE_BUTTON                DK_BTN4_MSK

/* A long press of the same button is the factory reset. */
#define FACTORY_RESET_BUTTON                IDENTIFY_MODE_BUTTON

LOG_MODULE_REGISTER(app, LOG_LEVEL_INF);

/* Application context: the attribute storage behind the endpoint's
 * clusters. ZBOSS reads and writes these structs; the application
 * owns them.
 */
struct zb_device_ctx {
	zb_zcl_basic_attrs_t basic_attr;
	zb_zcl_identify_attrs_t identify_attr;
	zb_uint8_t occupancy;
	zb_uint8_t occupancy_sensor_type;
	zb_uint8_t occupancy_sensor_type_bitmap;
};

/* Zigbee device application context storage. */
static struct zb_device_ctx dev_ctx;

ZB_ZCL_DECLARE_IDENTIFY_ATTRIB_LIST(
	identify_attr_list,
	&dev_ctx.identify_attr.identify_time);

ZB_ZCL_DECLARE_BASIC_ATTRIB_LIST(
	basic_attr_list,
	&dev_ctx.basic_attr.zcl_version,
	&dev_ctx.basic_attr.power_source);

ZB_ZCL_DECLARE_OCCUPANCY_SENSING_ATTRIB_LIST(
	occupancy_attr_list,
	&dev_ctx.occupancy,
	&dev_ctx.occupancy_sensor_type,
	&dev_ctx.occupancy_sensor_type_bitmap);

ZB_DECLARE_OCCUPANCY_SENSOR_CLUSTER_LIST(
	sensor_clusters,
	basic_attr_list,
	identify_attr_list,
	occupancy_attr_list);

ZB_DECLARE_OCCUPANCY_SENSOR_EP(
	sensor_ep,
	SENSOR_ENDPOINT,
	sensor_clusters);

ZBOSS_DECLARE_DEVICE_CTX_1_EP(
	sensor_ctx,
	sensor_ep);


/**@brief Function for initializing all clusters attributes. */
static void app_clusters_attr_init(void)
{
	/* Basic cluster attributes data */
	dev_ctx.basic_attr.zcl_version = ZB_ZCL_VERSION;
	dev_ctx.basic_attr.power_source = SENSOR_INIT_BASIC_POWER_SOURCE;

	/* Identify cluster attributes data. */
	dev_ctx.identify_attr.identify_time =
		ZB_ZCL_IDENTIFY_IDENTIFY_TIME_DEFAULT_VALUE;

	/* Occupancy Sensing attributes — see Step 1 for why an
	 * mmWave radar honestly reports sensor type ULTRASONIC:
	 * the ZCL enum has no radar value, and an active wave
	 * sensor belongs to the ultrasonic family, not to PIR.
	 */
	dev_ctx.occupancy =
		ZB_ZCL_OCCUPANCY_SENSING_OCCUPANCY_UNOCCUPIED;
	dev_ctx.occupancy_sensor_type =
		ZB_ZCL_OCCUPANCY_SENSING_OCCUPANCY_SENSOR_TYPE_ULTRASONIC;
	dev_ctx.occupancy_sensor_type_bitmap =
		ZB_ZCL_OCCUPANCY_SENSING_OCCUPANCY_SENSOR_TYPE_BITMAP_ULTRASONIC;
}

/**@brief Publish a new Occupancy value through the stack.
 *
 * Runs in ZBOSS scheduler context. ZB_ZCL_SET_ATTRIBUTE stores
 * the value in dev_ctx — and, new in Chapter 8, the stack's
 * reporting engine sees the write: if a coordinator configured
 * reporting for this attribute, a change that passes the
 * reportable-change test is emitted as a Report Attributes
 * command (subject to the min/max intervals), with no further
 * code here. The writer writes; the engine reports.
 *
 * @param  bufid  The new occupancy value (0 or 1), riding the
 *                scheduler's parameter slot.
 */
static void publish_occupancy(zb_bufid_t bufid)
{
	zb_uint8_t occupied = (zb_uint8_t)bufid;

	ZB_ZCL_SET_ATTRIBUTE(
		SENSOR_ENDPOINT,
		ZB_ZCL_CLUSTER_ID_OCCUPANCY_SENSING,
		ZB_ZCL_CLUSTER_SERVER_ROLE,
		ZB_ZCL_ATTR_OCCUPANCY_SENSING_OCCUPANCY_ID,
		&occupied,
		ZB_FALSE);

	LOG_INF("Occupancy attribute -> %s",
		occupied ? "OCCUPIED" : "UNOCCUPIED");
}

/* ------------------------------------------------------------------ */
/* The sensor glue — driver readings become attribute writes.          */
/* ------------------------------------------------------------------ */

static const struct device *const sensor_uart =
	DEVICE_DT_GET(DT_NODELABEL(uart1));

static struct k_work publish_work;

/* Workqueue context: re-read the FRESHEST snapshot (a burst of
 * frames between callback and work collapses into one truthful
 * write), derive the boolean, and hand the write to the stack's
 * own scheduler — attribute writes belong in ZBOSS context.
 */
static void publish_handler(struct k_work *work)
{
	ARG_UNUSED(work);

	struct ld2410_reading r;

	if (!ld2410_latest(&r)) {
		return;
	}

	zb_uint8_t occupied = (r.target != LD2410_TARGET_NONE) ?
		ZB_ZCL_OCCUPANCY_SENSING_OCCUPANCY_OCCUPIED :
		ZB_ZCL_OCCUPANCY_SENSING_OCCUPANCY_UNOCCUPIED;

	ZB_SCHEDULE_APP_CALLBACK(publish_occupancy, occupied);
}

/* Driver callback — parser-thread context, so: filter + defer,
 * exactly the contract ld2410.h states. The attribute is a
 * boolean, so the only event worth forwarding is a TRANSITION:
 * target appeared (NONE -> anything) or vanished (anything ->
 * NONE). Distance wiggles inside a state are Chapter 4's
 * deadband problem; a boolean has nothing to wiggle.
 */
static bool last_occupied;

static void on_reading(const struct ld2410_reading *r, void *user_data)
{
	ARG_UNUSED(user_data);

	bool occupied = (r->target != LD2410_TARGET_NONE);

	if (occupied != last_occupied) {
		last_occupied = occupied;
		k_work_submit(&publish_work);
	}
}

/* ------------------------------------------------------------------ */
/* The shell command — Chapter 4's `presence`, one line richer:        */
/* it now also shows what the NETWORK believes (the attribute).         */
/* ------------------------------------------------------------------ */

static const char *const target_words[] = {
	"nobody", "moving", "stationary", "moving + stationary"
};

static int cmd_presence(const struct shell *sh, size_t argc, char **argv)
{
	ARG_UNUSED(argc);
	ARG_UNUSED(argv);

	struct ld2410_reading r;
	struct ld2410_stats s;

	ld2410_stats(&s);

	if (!ld2410_latest(&r)) {
		shell_print(sh, "presence : no valid frame received yet");
	} else if (r.target == LD2410_TARGET_NONE) {
		shell_print(sh, "presence : no");
		shell_print(sh, "distance : —");
	} else {
		shell_print(sh, "presence : YES (%s)", target_words[(r.target < 4) ? r.target : 0]);
		shell_print(sh, "distance : %u cm",
			    ld2410_headline_distance_cm(&r));
	}

	shell_print(sh, "attribute: Occupancy = %u (%s)",
		    dev_ctx.occupancy,
		    dev_ctx.occupancy ? "OCCUPIED" : "UNOCCUPIED");
	shell_print(sh, "frames   : %u parsed, %u resyncs, %u dropped bytes, "
		    "%u engineering frames",
		    s.frames_ok, s.resyncs, s.rx_dropped, s.eng_frames);

	return 0;
}

SHELL_CMD_REGISTER(presence, NULL,
		   "Show live LD2410 presence, driver statistics, and the Occupancy attribute",
		   cmd_presence);

/**@brief Function to toggle the identify LED
 *
 * @param  bufid  Unused parameter, required by ZBOSS scheduler API.
 */
static void toggle_identify_led(zb_bufid_t bufid)
{
	static int blink_status;

	dk_set_led(IDENTIFY_LED, (++blink_status) % 2);
	ZB_SCHEDULE_APP_ALARM(toggle_identify_led, bufid, ZB_MILLISECONDS_TO_BEACON_INTERVAL(100));
}

/**@brief Function to handle identify notification events on the endpoint.
 *
 * @param  bufid  Unused parameter, required by ZBOSS scheduler API.
 */
static void identify_cb(zb_bufid_t bufid)
{
	zb_ret_t zb_err_code;

	if (bufid) {
		/* Schedule a self-scheduling function that will toggle the LED */
		ZB_SCHEDULE_APP_CALLBACK(toggle_identify_led, bufid);
	} else {
		/* Cancel the toggling function alarm and turn off LED */
		zb_err_code = ZB_SCHEDULE_APP_ALARM_CANCEL(toggle_identify_led, ZB_ALARM_ANY_PARAM);
		ZVUNUSED(zb_err_code);

		dk_set_led(IDENTIFY_LED, 0);
	}
}

/**@brief Starts identifying the device.
 *
 * @param  bufid  Unused parameter, required by ZBOSS scheduler API.
 */
static void start_identifying(zb_bufid_t bufid)
{
	ZVUNUSED(bufid);

	if (ZB_JOINED()) {
		if (dev_ctx.identify_attr.identify_time ==
		ZB_ZCL_IDENTIFY_IDENTIFY_TIME_DEFAULT_VALUE) {

			zb_ret_t zb_err_code = zb_bdb_finding_binding_target(
				SENSOR_ENDPOINT);

			if (zb_err_code == RET_OK) {
				LOG_INF("Enter identify mode");
			} else if (zb_err_code == RET_INVALID_STATE) {
				LOG_WRN("RET_INVALID_STATE - Cannot enter identify mode");
			} else {
				ZB_ERROR_CHECK(zb_err_code);
			}
		} else {
			LOG_INF("Cancel identify mode");
			zb_bdb_finding_binding_target_cancel();
		}
	} else {
		LOG_WRN("Device not in a network - cannot enter identify mode");
	}
}

/**@brief Callback for button events.
 *
 * Button 1's simulation job is done — the sensor owns occupancy
 * now. Button 4 keeps its Chapter 6 duties (identify / reset).
 */
static void button_changed(uint32_t button_state, uint32_t has_changed)
{
	if (IDENTIFY_MODE_BUTTON & has_changed) {
		if (IDENTIFY_MODE_BUTTON & button_state) {
			/* Button changed its state to pressed */
		} else {
			/* Button changed its state to released */
			if (was_factory_reset_done()) {
				/* The long press was for Factory Reset */
				LOG_DBG("After Factory Reset - ignore button release");
			} else   {
				/* Button released before Factory Reset */

				/* Start identification mode */
				ZB_SCHEDULE_APP_CALLBACK(start_identifying, 0);
			}
		}
	}

	check_factory_reset_button(button_state, has_changed);
}

/**@brief Function for initializing LEDs and Buttons. */
static void configure_gpio(void)
{
	int err;

	err = dk_buttons_init(button_changed);
	if (err) {
		LOG_ERR("Cannot init buttons (err: %d)", err);
	}

	err = dk_leds_init();
	if (err) {
		LOG_ERR("Cannot init LEDs (err: %d)", err);
	}
}

/**@brief Zigbee stack event handler — Chapter 6's, unchanged. */
void zboss_signal_handler(zb_bufid_t bufid)
{
	/* Update network status LED. */
	zigbee_led_status_update(bufid, ZIGBEE_NETWORK_STATE_LED);

	/* No application-specific behavior is required.
	 * Call default signal handler.
	 */
	ZB_ERROR_CHECK(zigbee_default_signal_handler(bufid));

	/* All callbacks should either reuse or free passed buffers.
	 * If bufid == 0, the buffer is invalid (not passed).
	 */
	if (bufid) {
		zb_buf_free(bufid);
	}
}

int main(void)
{
	LOG_INF("Starting Zigbee, Engineered - occupancy endpoint (reporting enabled)");

	/* Initialize */
	configure_gpio();
	register_factory_reset_button(FACTORY_RESET_BUTTON);

	/* Register device context (endpoints). */
	ZB_AF_REGISTER_DEVICE_CTX(&sensor_ctx);

	app_clusters_attr_init();

	/* Register handlers to identify notifications */
	ZB_AF_SET_IDENTIFY_NOTIFICATION_HANDLER(SENSOR_ENDPOINT, identify_cb);

	/* Start Chapter 4's driver on uart1 — the same call, the
	 * same contract as in its own chapter. A failed start is
	 * loud but not fatal to the Zigbee side: the endpoint still
	 * joins and answers (with a permanently unoccupied
	 * attribute), and the log says exactly why.
	 */
	k_work_init(&publish_work, publish_handler);

	int err = ld2410_start(sensor_uart, on_reading, NULL);

	if (err != 0) {
		LOG_ERR("LD2410 driver failed to start (%d) - "
			"endpoint will report UNOCCUPIED; check the overlay/wiring",
			err);
	}

	/* Start Zigbee default thread */
	zigbee_enable();

	LOG_INF("Endpoint 10 live: Occupancy follows the LD2410, and the "
		"endpoint now accepts reporting configuration - subscribe "
		"from the coordinator with zcl subscribe");

	return 0;
}
```

## include/zb_occupancy_sensor.h
```c
/*
 * Chapter 8, Step 1 — the Occupancy Sensor device declaration,
 * reporting edition.
 *
 * This is Chapter 7's header with exactly one change, and the
 * change is the chapter: the endpoint declaration now carries a
 * REPORTING CONTEXT — a fixed-size table (ZBOSS_DEVICE_DECLARE_
 * REPORTING_CTX) in which the stack records who asked to be told
 * about which attribute, and how often.
 *
 * Why a table has to exist at all: reporting configuration
 * arrives over the air (a coordinator's Configure Reporting
 * command) and must live somewhere typed, bounded and persistent
 * across the stack's scheduling. ZBOSS allocates that storage at
 * compile time from ZB_OCCUPANCY_SENSOR_REPORT_ATTR_COUNT — here
 * 1, because the Occupancy Sensing declare macro marks exactly
 * one attribute reportable:
 * ZB_ZCL_OCCUPANCY_SENSING_REPORT_ATTR_COUNT is 1 (Occupancy;
 * see zb_zcl_occupancy_sensing.h — the attribute is declared
 * ZB_ZCL_ATTR_ACCESS_REPORTING, its neighbours are not).
 *
 * Without this context the endpoint still builds and reads fine,
 * and every Configure Reporting command is answered "unsupported"
 * — the classic Chapter 8 bug: a silent device, correctly wired.
 * Chapter 8, Step 2's copy of this header adds the On/Off client
 * cluster; the reporting context carries over untouched.
 */

#ifndef ZB_OCCUPANCY_SENSOR_H
#define ZB_OCCUPANCY_SENSOR_H 1

/**
 *  @defgroup ZB_DEFINE_DEVICE_OCCUPANCY_SENSOR Occupancy Sensor
 *  @{
 *  @details
 *      - @ref ZB_ZCL_BASIC \n
 *      - @ref ZB_ZCL_IDENTIFY \n
 *      - @ref ZB_ZCL_OCCUPANCY_SENSING
 */

/** Occupancy Sensor Device ID (HA profile, ZCL device table) */
#define ZB_OCCUPANCY_SENSOR_DEVICE_ID 0x0107

/** Occupancy sensor device version */
#define ZB_DEVICE_VER_OCCUPANCY_SENSOR 0

/** @cond internals_doc */

/** Occupancy sensor IN (server) clusters number */
#define ZB_OCCUPANCY_SENSOR_IN_CLUSTER_NUM 3

/** Occupancy sensor OUT (client) clusters number */
#define ZB_OCCUPANCY_SENSOR_OUT_CLUSTER_NUM 0

#define ZB_OCCUPANCY_SENSOR_CLUSTER_NUM \
	(ZB_OCCUPANCY_SENSOR_IN_CLUSTER_NUM + ZB_OCCUPANCY_SENSOR_OUT_CLUSTER_NUM)

/** Number of attributes for reporting on Occupancy sensor device.
 * One: the Occupancy attribute is the cluster's only reportable
 * attribute (ZB_ZCL_OCCUPANCY_SENSING_REPORT_ATTR_COUNT).
 */
#define ZB_OCCUPANCY_SENSOR_REPORT_ATTR_COUNT \
	ZB_ZCL_OCCUPANCY_SENSING_REPORT_ATTR_COUNT

/** @endcond */ /* internals_doc */

/**
 * @brief Declare cluster list for Occupancy sensor device
 * @param cluster_list_name - cluster list variable name
 * @param basic_attr_list - attribute list for Basic cluster
 * @param identify_attr_list - attribute list for Identify cluster
 * @param occupancy_attr_list - attribute list for Occupancy Sensing cluster
 */
#define ZB_DECLARE_OCCUPANCY_SENSOR_CLUSTER_LIST(			      \
		cluster_list_name,					      \
		basic_attr_list,					      \
		identify_attr_list,					      \
		occupancy_attr_list)					      \
zb_zcl_cluster_desc_t cluster_list_name[] =				      \
{									      \
	ZB_ZCL_CLUSTER_DESC(						      \
		ZB_ZCL_CLUSTER_ID_BASIC,				      \
		ZB_ZCL_ARRAY_SIZE(basic_attr_list, zb_zcl_attr_t),	      \
		(basic_attr_list),					      \
		ZB_ZCL_CLUSTER_SERVER_ROLE,				      \
		ZB_ZCL_MANUF_CODE_INVALID				      \
	),								      \
	ZB_ZCL_CLUSTER_DESC(						      \
		ZB_ZCL_CLUSTER_ID_IDENTIFY,				      \
		ZB_ZCL_ARRAY_SIZE(identify_attr_list, zb_zcl_attr_t),	      \
		(identify_attr_list),					      \
		ZB_ZCL_CLUSTER_SERVER_ROLE,				      \
		ZB_ZCL_MANUF_CODE_INVALID				      \
	),								      \
	ZB_ZCL_CLUSTER_DESC(						      \
		ZB_ZCL_CLUSTER_ID_OCCUPANCY_SENSING,			      \
		ZB_ZCL_ARRAY_SIZE(occupancy_attr_list, zb_zcl_attr_t),	      \
		(occupancy_attr_list),					      \
		ZB_ZCL_CLUSTER_SERVER_ROLE,				      \
		ZB_ZCL_MANUF_CODE_INVALID				      \
	)								      \
}

/** @cond internals_doc */

/**
 * @brief Declare simple descriptor for Occupancy sensor device
 * @param ep_name - endpoint variable name
 * @param ep_id - endpoint ID
 * @param in_clust_num - number of supported input clusters
 * @param out_clust_num - number of supported output clusters
 */
#define ZB_ZCL_DECLARE_OCCUPANCY_SENSOR_SIMPLE_DESC(ep_name, ep_id, in_clust_num, out_clust_num) \
	ZB_DECLARE_SIMPLE_DESC(in_clust_num, out_clust_num);				       \
	ZB_AF_SIMPLE_DESC_TYPE(in_clust_num, out_clust_num) simple_desc_##ep_name =	       \
	{										       \
		ep_id,									       \
		ZB_AF_HA_PROFILE_ID,							       \
		ZB_OCCUPANCY_SENSOR_DEVICE_ID,						       \
		ZB_DEVICE_VER_OCCUPANCY_SENSOR,						       \
		0,									       \
		in_clust_num,								       \
		out_clust_num,								       \
		{									       \
			ZB_ZCL_CLUSTER_ID_BASIC,					       \
			ZB_ZCL_CLUSTER_ID_IDENTIFY,					       \
			ZB_ZCL_CLUSTER_ID_OCCUPANCY_SENSING				       \
		}									       \
	}

/** @endcond */

/**
 * @brief Declare endpoint for Occupancy sensor device
 * @param ep_name - endpoint variable name
 * @param ep_id - endpoint ID
 * @param cluster_list - endpoint cluster list
 */
#define ZB_DECLARE_OCCUPANCY_SENSOR_EP(ep_name, ep_id, cluster_list)			      \
	ZB_ZCL_DECLARE_OCCUPANCY_SENSOR_SIMPLE_DESC(ep_name, ep_id,			      \
		ZB_OCCUPANCY_SENSOR_IN_CLUSTER_NUM, ZB_OCCUPANCY_SENSOR_OUT_CLUSTER_NUM);     \
	ZBOSS_DEVICE_DECLARE_REPORTING_CTX(reporting_info## ep_name,			      \
		ZB_OCCUPANCY_SENSOR_REPORT_ATTR_COUNT);				      \
	ZB_AF_DECLARE_ENDPOINT_DESC(ep_name, ep_id, ZB_AF_HA_PROFILE_ID, 0, NULL,	      \
		ZB_ZCL_ARRAY_SIZE(cluster_list, zb_zcl_cluster_desc_t), cluster_list,	      \
			(zb_af_simple_desc_1_1_t *)&simple_desc_##ep_name,		      \
			ZB_OCCUPANCY_SENSOR_REPORT_ATTR_COUNT,				      \
				reporting_info## ep_name,				      \
			0, NULL) /* No CVC ctx */

/*! @} */

#endif /* ZB_OCCUPANCY_SENSOR_H */
```

## src/ld2410.c
```c
/*
 * ld2410.c — the LD2410 driver: Step 2's parser, behind an interface.
 *
 * Structure (the same layers as Steps 1–2, now owned by the driver):
 *
 *   UART IRQ          drains the hardware FIFO into a ring buffer
 *   parser thread     wakes on a semaphore, drains the ring, feeds
 *                     the state machine, and for every VALID frame:
 *                       1. stores the reading as the latest snapshot
 *                       2. invokes the application callback
 *   application       never sees a byte. It sees readings.
 *
 * The frame format comments live on the parser below. Where the
 * protocol document leaves room for doubt, the code says so.
 */

#include "ld2410.h"

#include <zephyr/kernel.h>
#include <zephyr/devicetree.h>
#include <zephyr/drivers/uart.h>
#include <zephyr/sys/ring_buffer.h>
#include <zephyr/sys/byteorder.h>
#include <zephyr/logging/log.h>
#include <hal/nrf_uarte.h>

#include <errno.h>
#include <string.h>

LOG_MODULE_REGISTER(ld2410, LOG_LEVEL_INF);

/* ------------------------------------------------------------------ */
/* Receive path.                                                       */
/* ------------------------------------------------------------------ */

#define LD2410_RING_SIZE 1024		/* power of two (byte ring rule) */
#define LD2410_THREAD_STACK 2048
#define LD2410_THREAD_PRIO 7		/* same tier as the app's helpers */

RING_BUF_DECLARE(ld2410_ring, LD2410_RING_SIZE);
static K_SEM_DEFINE(ld2410_sem, 0, 1);

/* Bytes lost to a full ring, counted in the ISR — the one piece of
 * driver state interrupt context may touch, and atomic precisely
 * because the parser thread folds it into the published stats.
 */
static atomic_t ld2410_isr_dropped;

static const struct device *ld2410_uart;
static ld2410_callback_t ld2410_cb;
static void *ld2410_cb_user;
static bool ld2410_started;

static struct ld2410_stats ld2410_stats_live;	/* driver threads only */
static struct ld2410_stats ld2410_stats_pub;	/* mutex-guarded copy  */
static struct ld2410_reading ld2410_latest_snap;
static bool ld2410_have_reading;
static K_MUTEX_DEFINE(ld2410_lock);

static void ld2410_uart_isr(const struct device *dev, void *user_data)
{
	ARG_UNUSED(user_data);

	uint8_t chunk[32];

	if (!uart_irq_update(dev)) {
		return;
	}

	while (uart_irq_rx_ready(dev)) {
		int n = uart_fifo_read(dev, chunk, sizeof(chunk));

		if (n <= 0) {
			break;
		}

		uint32_t stored = ring_buf_put(&ld2410_ring, chunk, (uint32_t)n);

		if (stored < (uint32_t)n) {
			/* The one counter written from ISR context:
			 * atomic, and mirrored into the published
			 * stats by the parser thread.
			 */
			atomic_add(&ld2410_isr_dropped, n - (int)stored);
		}

		k_sem_give(&ld2410_sem);
	}
}

/* ------------------------------------------------------------------ */
/* The parser — Step 2's state machine, unchanged in spirit.           */
/*                                                                     */
/* Frame: F4 F3 F2 F1 | len u16 LE | payload[len] | F8 F7 F6 F5        */
/* Basic report payload (len 13):                                      */
/*   [0] 0x02 type · [1] 0xAA · [2] target state · [3..4] move dist    */
/*   LE cm · [5] move energy · [6..7] still dist LE cm · [8] still     */
/*   energy · [9..10] detection dist LE cm · [11] 0x55 · [12] 0x00     */
/* No checksum exists in this protocol; markers + length + footer      */
/* are the validation, and resyncs are counted, never hidden.          */
/* ------------------------------------------------------------------ */

#define LD2410_TYPE_BASIC 0x02
#define LD2410_TYPE_ENGINEERING 0x01
#define LD2410_MAX_PAYLOAD 64

enum parser_state { PS_HUNT, PS_LEN, PS_PAYLOAD, PS_FOOTER };

static const uint8_t header_seq[4] = { 0xF4, 0xF3, 0xF2, 0xF1 };
static const uint8_t footer_seq[4] = { 0xF8, 0xF7, 0xF6, 0xF5 };

static enum parser_state ps_state;
static uint8_t ps_match;
static uint16_t ps_len;
static uint8_t ps_len_bytes;
static uint8_t ps_payload[LD2410_MAX_PAYLOAD];
static uint16_t ps_payload_pos;

static void parser_reset(void)
{
	ps_state = PS_HUNT;
	ps_match = 0;
	ps_len = 0;
	ps_len_bytes = 0;
	ps_payload_pos = 0;
}

static void parser_abort(void)
{
	ld2410_stats_live.resyncs++;
	LOG_WRN("resync #%u (frames ok: %u)",
		ld2410_stats_live.resyncs, ld2410_stats_live.frames_ok);
	parser_reset();
}

static void publish_reading(const struct ld2410_reading *r)
{
	k_mutex_lock(&ld2410_lock, K_FOREVER);
	ld2410_latest_snap = *r;
	ld2410_have_reading = true;
	ld2410_stats_live.frames_ok++;
	ld2410_stats_pub = ld2410_stats_live;
	k_mutex_unlock(&ld2410_lock);

	LOG_DBG("frame #%u: target %d, move %u cm (e%u), still %u cm (e%u)",
		ld2410_stats_live.frames_ok, r->target,
		r->move_distance_cm, r->move_energy,
		r->still_distance_cm, r->still_energy);

	if (ld2410_cb != NULL) {
		ld2410_cb(r, ld2410_cb_user);
	}
}

static void handle_payload(void)
{
	if (ps_payload[0] == LD2410_TYPE_ENGINEERING) {
		/* Documented mode, deliberately not decoded in
		 * this course. Counted, and mirrored to the
		 * published stats so the shell can show it.
		 */
		ld2410_stats_live.eng_frames++;
		k_mutex_lock(&ld2410_lock, K_FOREVER);
		ld2410_stats_pub = ld2410_stats_live;
		k_mutex_unlock(&ld2410_lock);
		return;
	}

	if (ps_payload[0] != LD2410_TYPE_BASIC || ps_len != 13 ||
	    ps_payload[1] != 0xAA || ps_payload[11] != 0x55 ||
	    ps_payload[12] != 0x00) {
		parser_abort();
		return;
	}

	/* No checksum exists in this protocol, so valid markers do
	 * not make the payload trustworthy: the target-state byte can
	 * still be anything. Only 0..3 name a target; reject anything
	 * else here, before the value is published as a reading and
	 * used to index the app's 4-entry target_words table.
	 */
	if (ps_payload[2] > 3) {
		parser_abort();
		return;
	}

	struct ld2410_reading r = {
		.target = (enum ld2410_target)ps_payload[2],
		.move_distance_cm = sys_get_le16(&ps_payload[3]),
		.move_energy = ps_payload[5],
		.still_distance_cm = sys_get_le16(&ps_payload[6]),
		.still_energy = ps_payload[8],
		.detect_distance_cm = sys_get_le16(&ps_payload[9]),
		.timestamp_ms = k_uptime_get(),
	};

	publish_reading(&r);
}

static void parser_feed(uint8_t byte)
{
	switch (ps_state) {
	case PS_HUNT:
		if (byte == header_seq[ps_match]) {
			ps_match++;
			if (ps_match == sizeof(header_seq)) {
				ps_state = PS_LEN;
				ps_match = 0;
				ps_len = 0;
				ps_len_bytes = 0;
			}
		} else {
			ps_match = (byte == header_seq[0]) ? 1 : 0;
		}
		break;

	case PS_LEN:
		ps_len |= (uint16_t)byte << (8 * ps_len_bytes);
		ps_len_bytes++;
		if (ps_len_bytes == 2) {
			if (ps_len < 3 || ps_len > LD2410_MAX_PAYLOAD) {
				parser_abort();
			} else {
				ps_state = PS_PAYLOAD;
				ps_payload_pos = 0;
			}
		}
		break;

	case PS_PAYLOAD:
		ps_payload[ps_payload_pos++] = byte;
		if (ps_payload_pos >= ps_len) {
			ps_state = PS_FOOTER;
			ps_match = 0;
		}
		break;

	case PS_FOOTER:
		if (byte == footer_seq[ps_match]) {
			ps_match++;
			if (ps_match == sizeof(footer_seq)) {
				handle_payload();
				parser_reset();
			}
		} else {
			parser_abort();
			if (byte == header_seq[0]) {
				ps_state = PS_HUNT;
				ps_match = 1;
			}
		}
		break;
	}
}

/* ------------------------------------------------------------------ */
/* The parser thread — the driver's engine room.                       */
/* ------------------------------------------------------------------ */

static void ld2410_thread(void *p1, void *p2, void *p3)
{
	ARG_UNUSED(p1);
	ARG_UNUSED(p2);
	ARG_UNUSED(p3);

	uint8_t bytes[64];

	while (1) {
		k_sem_take(&ld2410_sem, K_FOREVER);

		/* Fold any ISR-side drops into the published stats
		 * here, in thread context, where the mutex is legal.
		 */
		long dropped = atomic_set(&ld2410_isr_dropped, 0);

		if (dropped != 0) {
			k_mutex_lock(&ld2410_lock, K_FOREVER);
			ld2410_stats_live.rx_dropped += (uint32_t)dropped;
			ld2410_stats_pub = ld2410_stats_live;
			k_mutex_unlock(&ld2410_lock);
		}

		uint32_t n;

		while ((n = ring_buf_get(&ld2410_ring, bytes, sizeof(bytes))) > 0) {
			for (uint32_t i = 0; i < n; i++) {
				parser_feed(bytes[i]);
			}
		}
	}
}

K_THREAD_DEFINE(ld2410_thread_id, LD2410_THREAD_STACK, ld2410_thread,
		NULL, NULL, NULL, LD2410_THREAD_PRIO, 0, 0);

/* ------------------------------------------------------------------ */
/* The public interface (the contract is in ld2410.h).                 */
/* ------------------------------------------------------------------ */

int ld2410_start(const struct device *uart, ld2410_callback_t cb,
		 void *user_data)
{
	if (ld2410_started) {
		return -EALREADY;
	}
	if (!device_is_ready(uart)) {
		return -ENODEV;
	}

	ld2410_uart = uart;
	ld2410_cb = cb;
	ld2410_cb_user = user_data;

	parser_reset();

	/*
	 * The module's 256,000 baud exists in NEITHER of Zephyr's
	 * baud tables for this chip — the devicetree binding
	 * rejects it and the UARTE driver's lookup returns
	 * -EINVAL (Step 1 tells the whole story). So the driver
	 * writes the divider register directly, from the
	 * nRF52840 datasheet formula:
	 *
	 *     BAUDRATE = baud * 2^32 / 16,000,000  (peripheral clock)
	 *
	 * giving an actual rate of 255,999.997. The `uart` device
	 * handed in is uart1 (see the application); its register
	 * block comes from that same devicetree node. Owning this
	 * quirk HERE — one place, commented — is what makes it a
	 * driver detail instead of an application bug.
	 */
	nrf_uarte_baudrate_set(
		(NRF_UARTE_Type *)DT_REG_ADDR(DT_NODELABEL(uart1)),
		(nrf_uarte_baudrate_t)((256000ULL << 32) / 16000000ULL));

	uart_irq_callback_user_data_set(ld2410_uart, ld2410_uart_isr, NULL);
	uart_irq_rx_enable(ld2410_uart);

	ld2410_started = true;

	LOG_INF("LD2410 driver started (basic reporting mode expected)");

	return 0;
}

bool ld2410_latest(struct ld2410_reading *out)
{
	k_mutex_lock(&ld2410_lock, K_FOREVER);
	bool have = ld2410_have_reading;

	if (have && out != NULL) {
		*out = ld2410_latest_snap;
	}
	k_mutex_unlock(&ld2410_lock);

	return have;
}

void ld2410_stats(struct ld2410_stats *out)
{
	k_mutex_lock(&ld2410_lock, K_FOREVER);
	if (out != NULL) {
		*out = ld2410_stats_pub;
	}
	k_mutex_unlock(&ld2410_lock);
}

uint16_t ld2410_headline_distance_cm(const struct ld2410_reading *r)
{
	if (r == NULL) {
		return 0;
	}

	switch (r->target) {
	case LD2410_TARGET_STATIONARY:
	case LD2410_TARGET_BOTH:
		return r->still_distance_cm;
	case LD2410_TARGET_MOVING:
		return r->move_distance_cm;
	default:
		return 0;
	}
}
```
