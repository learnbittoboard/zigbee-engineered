## CMakeLists.txt
```
# Chapter 2, Step 3 — Kconfig options and per-module log levels.
cmake_minimum_required(VERSION 3.20.0)
find_package(Zephyr REQUIRED HINTS $ENV{ZEPHYR_BASE})
project(ch02_kconfig)

target_sources(app PRIVATE src/main.c src/sensor_sim.c)
```

## Kconfig
```
# Chapter 2, Step 3 — the application's OWN Kconfig options.
#
# A file named "Kconfig" in the application root is picked up by the
# build automatically. This is where the product defines the knobs
# that belong to IT (as opposed to CONFIG_* options that belong to
# Zephyr itself, which we only SET in prj.conf).
#
# The last line is mandatory in an application Kconfig file: it pulls
# in the rest of the Zephyr Kconfig tree.

menu "Room sensor demo"

config ROOM_BLINK_PERIOD_MS
	int "Sensor poll / heartbeat period (ms)"
	default 1000
	help
	  How often the main loop polls the simulated sensor. A product
	  tunes numbers like this without touching C code — prj.conf (or
	  a board-specific config fragment) just overrides the default.

config ROOM_FEATURE_HEARTBEAT_LOG
	bool "Print a heartbeat log line every period"
	default y
	help
	  A demo "feature switch": when this is off, the heartbeat code
	  is not merely skipped at runtime — it is compiled out of the
	  firmware entirely, because main.c tests it with IS_ENABLED().

endmenu

# Per-module log-level symbols for OUR OWN module do not appear by
# magic: they exist only where a Kconfig file instantiates Zephyr's
# log-config template for that module name. Zephyr's subsystems do
# this for their modules; this line does it for "sim", creating
# CONFIG_SIM_LOG_LEVEL_DBG and friends — which is what allows
# prj.conf to raise just this one module to DBG.
module = SIM
module-str = Simulated sensor (Chapter 2 demo)
source "subsys/logging/Kconfig.template.log_config"

source "Kconfig.zephyr"
```

## prj.conf
```kconfig
# Chapter 2, Step 3 — configuration.
# prj.conf SETS options; ./Kconfig (this app's own file) DEFINES the
# ROOM_* ones. Read both files together — that pairing is the lesson.

CONFIG_LOG=y
CONFIG_MAIN_STACK_SIZE=2048

# Override the Kconfig default (1000 ms) WITHOUT touching C or the
# Kconfig file. Same source, faster heartbeat, purely by config.
CONFIG_ROOM_BLINK_PERIOD_MS=250

# The heartbeat feature stays ON (its Kconfig default). Setting
# CONFIG_ROOM_FEATURE_HEARTBEAT_LOG=n here would compile the
# heartbeat code out of the image entirely — try it (README).

# Per-module log levels: the whole app is INF, but the sensor_sim
# module ("sim") is raised to DBG. One line, one module, no global
# noise. This is how real products keep one suspect subsystem loud
# while everything else whispers.
CONFIG_SIM_LOG_LEVEL_DBG=y
```

## src/main.c
```c
/*
 * Chapter 2, Step 3 — Kconfig: software, configured.
 *
 * The devicetree (Step 2) describes HARDWARE. Kconfig configures
 * SOFTWARE: which features exist, and the numbers that tune them.
 *
 * Two files divide the work, and confusing them is the classic
 * beginner mix-up:
 *
 *   Kconfig   DEFINES options (this app's own are in ./Kconfig,
 *             next to this file's folder) — types, defaults, help.
 *   prj.conf  SETS values for those options for this build.
 *
 * main.c then just reads CONFIG_* macros. Change the value in
 * prj.conf, rebuild — the C code never changed. That is exactly how
 * the same firmware ships in a "quiet" and a "debug" variant.
 */

#include <zephyr/kernel.h>
#include <zephyr/logging/log.h>

#include "sensor_sim.h"

LOG_MODULE_REGISTER(app, LOG_LEVEL_INF);

int main(void)
{
	LOG_INF("kconfig demo: period = %d ms, heartbeat feature %s",
		CONFIG_ROOM_BLINK_PERIOD_MS,
		IS_ENABLED(CONFIG_ROOM_FEATURE_HEARTBEAT_LOG) ? "ON" : "OFF");

	int32_t beats = 0;

	while (1) {
		/* One poll of the simulated sensor (its own module —
		 * watch its log lines: it is allowed to be noisier
		 * than `app`, because prj.conf says so).
		 */
		int32_t distance = sensor_sim_read();

		/*
		 * IS_ENABLED() turns the option into a compile-time
		 * 1 or 0. With the feature off, this whole block is
		 * removed by the compiler: zero flash, zero CPU.
		 * That is the difference between a feature FLAG in
		 * Kconfig and an `if` on a variable.
		 */
		if (IS_ENABLED(CONFIG_ROOM_FEATURE_HEARTBEAT_LOG)) {
			beats++;
			LOG_INF("heartbeat %d: distance = %d mm",
				beats, distance);
		}

		k_sleep(K_MSEC(CONFIG_ROOM_BLINK_PERIOD_MS));
	}

	return 0;
}
```

## src/sensor_sim.c
```c
/*
 * A pretend sensor in its OWN source file — so it can be its OWN
 * logging module.
 *
 * This is the second half of the step's lesson: log levels are
 * per-MODULE, not per-application. This file registers the module
 * "sim"; main.c registers "app". prj.conf then turns sim up to DBG
 * while app stays at INF — one noisy corner, a quiet product.
 */

#include <zephyr/kernel.h>
#include <zephyr/logging/log.h>

#include "sensor_sim.h"

/* Default level INF here; prj.conf raises this module to DBG. */
LOG_MODULE_REGISTER(sim, LOG_LEVEL_INF);

int32_t sensor_sim_read(void)
{
	int64_t t = k_uptime_get() / 100;	/* tenths of a second */
	int32_t distance = 300 + (int32_t)((t * 137) % 4700);

	/* DBG: invisible until prj.conf allows this module to speak
	 * at debug level. Remove the CONFIG_SIM_LOG_LEVEL_DBG line
	 * from prj.conf and this message vanishes — same code.
	 */
	LOG_DBG("raw sample: t=%lld, distance=%d mm",
		k_uptime_get(), distance);

	return distance;
}
```

## src/sensor_sim.h
```c
#ifndef SENSOR_SIM_H_
#define SENSOR_SIM_H_

#include <stdint.h>

/* Returns one fake distance reading in millimetres, 300..5000. */
int32_t sensor_sim_read(void);

#endif /* SENSOR_SIM_H_ */
```
