## CMakeLists.txt
```
# Chapter 7, Step 2 — The endpoint meets the sensor: LD2410 included.
cmake_minimum_required(VERSION 3.20.0)
find_package(Zephyr REQUIRED HINTS $ENV{ZEPHYR_BASE})
project(ch07_sensor_attribute)

target_sources(app PRIVATE src/main.c src/ld2410.c)
target_include_directories(app PRIVATE include)
```

## Kconfig
```
# Chapter 7, Step 2 — the application's own Kconfig.
#
# This app defines no product knobs of its own (Chapter 8 adds
# the first); the file exists for the two lines at the bottom.
# Per-module log-level symbols for OUR driver do not appear by
# magic: they exist only where a Kconfig file instantiates
# Zephyr's log-config template for that module name (Chapter 2,
# Step 3 taught this; Chapter 4's driver app did it first). This
# does it for LD2410, creating CONFIG_LD2410_LOG_LEVEL_DBG and
# friends — which is what lets prj.conf aim the driver's log
# level without touching the application module.

module = LD2410
module-str = HLK-LD2410 driver (Chapters 4 + 7)
source "subsys/logging/Kconfig.template.log_config"

source "Kconfig.zephyr"
```

## prj.conf
```kconfig
#
# Chapter 7, Step 2 — the Occupancy Sensing endpoint, sensor-driven.
# The Chapter 6/7 Zigbee configuration is unchanged; the additions
# are Chapter 4's receive path (ring buffer) and the shell.
#

CONFIG_NCS_SAMPLES_DEFAULTS=y

# Serial console (the DK's USB UART) for logs.
CONFIG_UART_INTERRUPT_DRIVEN=y
CONFIG_SERIAL=y
CONFIG_GPIO=y
CONFIG_CONSOLE=y
CONFIG_UART_CONSOLE=y

CONFIG_HEAP_MEM_POOL_SIZE=2048
CONFIG_MAIN_THREAD_PRIORITY=7

# The Zigbee R23 add-on itself, the application utilities, and
# this device's role: ROUTER.
CONFIG_ZIGBEE_ADD_ON=y
CONFIG_ZIGBEE_APP_UTILS=y
CONFIG_ZIGBEE_ROLE_ROUTER=y

# Enable DK LED and Buttons library
CONFIG_DK_LIBRARY=y

# This example requires more workqueue stack
CONFIG_SYSTEM_WORKQUEUE_STACK_SIZE=2048

# --- Chapter 4's driver, riding along ------------------------------
# The LD2410 receive path: interrupt-driven UART into a ring
# buffer, parser thread behind it (src/ld2410.c, unchanged).
CONFIG_RING_BUFFER=y

# The driver's own log module stays at INF: startup and resync
# warnings only. (The symbol exists because this app's Kconfig
# instantiates the log template for the LD2410 module name.)
CONFIG_LD2410_LOG_LEVEL_INF=y

# Chapter 1's shell, pointed at a Zigbee product: the app's
# `presence` command (src/main.c) shows the live reading, the
# driver counters, and the attribute the network can read.
CONFIG_SHELL=y
```

## boards/nrf52840dk_nrf52840.overlay
```dts
/*
 * Copyright (c) 2025 Nordic Semiconductor ASA
 *
 * SPDX-License-Identifier: LicenseRef-Nordic-5-Clause
 */

#include <nrf52840_partitions.dtsi>

/ {
	chosen {
		ncs,zigbee-timer = &timer2;
	};
};

&timer2 {
	status = "okay";
};

/*
 * Chapter 7, Step 2 addition: the LD2410's UART.
 *
 * uart1 (RX P1.01, TX P1.02) ships disabled in the SoC; enabling
 * it is this block's whole job — the same overlay Chapter 4 used.
 * The baud rate is NOT set here: the module's 256,000 baud is
 * absent from Zephyr's devicetree baud table for this chip, so
 * the driver sets the UARTE divider register directly (the full
 * story is Chapter 4's fix F3; ld2410.c owns the quirk).
 */
&uart1 {
	status = "okay";
};
```

## src/main.c
```c
/*
 * Chapter 7, Step 2 — the endpoint meets the sensor.
 *
 * The endpoint declaration is Step 1's, byte for byte: same
 * device header, same attribute storage, same publish path.
 * What changes is who calls it. The thumb retires; Chapter 4's
 * LD2410 driver (src/ld2410.c, included UNCHANGED — same contract
 * it had in Chapter 4) now produces the readings, and a thin
 * layer of application glue turns "target present / target gone"
 * into Occupancy attribute writes:
 *
 *   LD2410 frame -> driver callback (parser thread)
 *                -> transition filter (state changed?)
 *                -> work item (system workqueue)
 *                -> ZBOSS-scheduled publish_occupancy()
 *                -> ZB_ZCL_SET_ATTRIBUTE (stack context)
 *
 * Three contexts, three jobs, each doing only what it may —
 * Chapter 2's and Chapter 3's rules, now with cargo. Note what
 * the Zigbee side never sees: a byte, a frame, a distance. The
 * driver contract said Chapter 7 would consume the interface and
 * never a byte. It was right.
 *
 * The desk check is the coordinator's: read cluster 0x0406,
 * attribute 0x0000 from the shell while someone walks in and out
 * of the sensor's view. The DK-side `presence` shell command
 * (Chapter 4's, extended) shows the same truth from our side.
 */

#include <zephyr/kernel.h>
#include <zephyr/device.h>
#include <zephyr/devicetree.h>
#include <zephyr/logging/log.h>
#include <zephyr/shell/shell.h>
#include <dk_buttons_and_leds.h>

#include <zboss_api.h>
#include <zigbee/zigbee_error_handler.h>
#include <zigbee/zigbee_app_utils.h>
#include <zb_nrf_platform.h>
#include "zb_occupancy_sensor.h"

#include "ld2410.h"


/* Device endpoint — the same number Chapters 6–7 use throughout. */
#define SENSOR_ENDPOINT                     10

/* Type of power sources available for the device.
 * For possible values see section 3.2.2.2.8 of ZCL specification.
 */
#define SENSOR_INIT_BASIC_POWER_SOURCE      ZB_ZCL_BASIC_POWER_SOURCE_DC_SOURCE

/* LED indicating that device successfully joined Zigbee network. */
#define ZIGBEE_NETWORK_STATE_LED            DK_LED3

/* LED used for device identification. */
#define IDENTIFY_LED                        DK_LED4

/* Button used to enter the Identify mode. */
#define IDENTIFY_MODE_BUTTON                DK_BTN4_MSK

/* A long press of the same button is the factory reset. */
#define FACTORY_RESET_BUTTON                IDENTIFY_MODE_BUTTON

LOG_MODULE_REGISTER(app, LOG_LEVEL_INF);

/* Application context: the attribute storage behind the endpoint's
 * clusters. ZBOSS reads and writes these structs; the application
 * owns them.
 */
struct zb_device_ctx {
	zb_zcl_basic_attrs_t basic_attr;
	zb_zcl_identify_attrs_t identify_attr;
	zb_uint8_t occupancy;
	zb_uint8_t occupancy_sensor_type;
	zb_uint8_t occupancy_sensor_type_bitmap;
};

/* Zigbee device application context storage. */
static struct zb_device_ctx dev_ctx;

ZB_ZCL_DECLARE_IDENTIFY_ATTRIB_LIST(
	identify_attr_list,
	&dev_ctx.identify_attr.identify_time);

ZB_ZCL_DECLARE_BASIC_ATTRIB_LIST(
	basic_attr_list,
	&dev_ctx.basic_attr.zcl_version,
	&dev_ctx.basic_attr.power_source);

ZB_ZCL_DECLARE_OCCUPANCY_SENSING_ATTRIB_LIST(
	occupancy_attr_list,
	&dev_ctx.occupancy,
	&dev_ctx.occupancy_sensor_type,
	&dev_ctx.occupancy_sensor_type_bitmap);

ZB_DECLARE_OCCUPANCY_SENSOR_CLUSTER_LIST(
	sensor_clusters,
	basic_attr_list,
	identify_attr_list,
	occupancy_attr_list);

ZB_DECLARE_OCCUPANCY_SENSOR_EP(
	sensor_ep,
	SENSOR_ENDPOINT,
	sensor_clusters);

ZBOSS_DECLARE_DEVICE_CTX_1_EP(
	sensor_ctx,
	sensor_ep);


/**@brief Function for initializing all clusters attributes. */
static void app_clusters_attr_init(void)
{
	/* Basic cluster attributes data */
	dev_ctx.basic_attr.zcl_version = ZB_ZCL_VERSION;
	dev_ctx.basic_attr.power_source = SENSOR_INIT_BASIC_POWER_SOURCE;

	/* Identify cluster attributes data. */
	dev_ctx.identify_attr.identify_time =
		ZB_ZCL_IDENTIFY_IDENTIFY_TIME_DEFAULT_VALUE;

	/* Occupancy Sensing attributes — see Step 1 for why an
	 * mmWave radar honestly reports sensor type ULTRASONIC:
	 * the ZCL enum has no radar value, and an active wave
	 * sensor belongs to the ultrasonic family, not to PIR.
	 */
	dev_ctx.occupancy =
		ZB_ZCL_OCCUPANCY_SENSING_OCCUPANCY_UNOCCUPIED;
	dev_ctx.occupancy_sensor_type =
		ZB_ZCL_OCCUPANCY_SENSING_OCCUPANCY_SENSOR_TYPE_ULTRASONIC;
	dev_ctx.occupancy_sensor_type_bitmap =
		ZB_ZCL_OCCUPANCY_SENSING_OCCUPANCY_SENSOR_TYPE_BITMAP_ULTRASONIC;
}

/**@brief Publish a new Occupancy value through the stack.
 *
 * Runs in ZBOSS scheduler context. ZB_ZCL_SET_ATTRIBUTE stores
 * the value in dev_ctx AND wakes the stack's reporting machinery
 * for reportable attributes — Chapter 8 turns that machinery on.
 *
 * @param  bufid  The new occupancy value (0 or 1), riding the
 *                scheduler's parameter slot.
 */
static void publish_occupancy(zb_bufid_t bufid)
{
	zb_uint8_t occupied = (zb_uint8_t)bufid;

	ZB_ZCL_SET_ATTRIBUTE(
		SENSOR_ENDPOINT,
		ZB_ZCL_CLUSTER_ID_OCCUPANCY_SENSING,
		ZB_ZCL_CLUSTER_SERVER_ROLE,
		ZB_ZCL_ATTR_OCCUPANCY_SENSING_OCCUPANCY_ID,
		&occupied,
		ZB_FALSE);

	LOG_INF("Occupancy attribute -> %s",
		occupied ? "OCCUPIED" : "UNOCCUPIED");
}

/* ------------------------------------------------------------------ */
/* The sensor glue — driver readings become attribute writes.          */
/* ------------------------------------------------------------------ */

static const struct device *const sensor_uart =
	DEVICE_DT_GET(DT_NODELABEL(uart1));

static struct k_work publish_work;

/* Workqueue context: re-read the FRESHEST snapshot (a burst of
 * frames between callback and work collapses into one truthful
 * write), derive the boolean, and hand the write to the stack's
 * own scheduler — attribute writes belong in ZBOSS context.
 */
static void publish_handler(struct k_work *work)
{
	ARG_UNUSED(work);

	struct ld2410_reading r;

	if (!ld2410_latest(&r)) {
		return;
	}

	zb_uint8_t occupied = (r.target != LD2410_TARGET_NONE) ?
		ZB_ZCL_OCCUPANCY_SENSING_OCCUPANCY_OCCUPIED :
		ZB_ZCL_OCCUPANCY_SENSING_OCCUPANCY_UNOCCUPIED;

	ZB_SCHEDULE_APP_CALLBACK(publish_occupancy, occupied);
}

/* Driver callback — parser-thread context, so: filter + defer,
 * exactly the contract ld2410.h states. The attribute is a
 * boolean, so the only event worth forwarding is a TRANSITION:
 * target appeared (NONE -> anything) or vanished (anything ->
 * NONE). Distance wiggles inside a state are Chapter 4's
 * deadband problem; a boolean has nothing to wiggle.
 */
static bool last_occupied;

static void on_reading(const struct ld2410_reading *r, void *user_data)
{
	ARG_UNUSED(user_data);

	bool occupied = (r->target != LD2410_TARGET_NONE);

	if (occupied != last_occupied) {
		last_occupied = occupied;
		k_work_submit(&publish_work);
	}
}

/* ------------------------------------------------------------------ */
/* The shell command — Chapter 4's `presence`, one line richer:        */
/* it now also shows what the NETWORK believes (the attribute).         */
/* ------------------------------------------------------------------ */

static const char *const target_words[] = {
	"nobody", "moving", "stationary", "moving + stationary"
};

static int cmd_presence(const struct shell *sh, size_t argc, char **argv)
{
	ARG_UNUSED(argc);
	ARG_UNUSED(argv);

	struct ld2410_reading r;
	struct ld2410_stats s;

	ld2410_stats(&s);

	if (!ld2410_latest(&r)) {
		shell_print(sh, "presence : no valid frame received yet");
	} else if (r.target == LD2410_TARGET_NONE) {
		shell_print(sh, "presence : no");
		shell_print(sh, "distance : —");
	} else {
		shell_print(sh, "presence : YES (%s)", target_words[(r.target < 4) ? r.target : 0]);
		shell_print(sh, "distance : %u cm",
			    ld2410_headline_distance_cm(&r));
	}

	shell_print(sh, "attribute: Occupancy = %u (%s)",
		    dev_ctx.occupancy,
		    dev_ctx.occupancy ? "OCCUPIED" : "UNOCCUPIED");
	shell_print(sh, "frames   : %u parsed, %u resyncs, %u dropped bytes, "
		    "%u engineering frames",
		    s.frames_ok, s.resyncs, s.rx_dropped, s.eng_frames);

	return 0;
}

SHELL_CMD_REGISTER(presence, NULL,
		   "Show live LD2410 presence, driver statistics, and the Occupancy attribute",
		   cmd_presence);

/**@brief Function to toggle the identify LED
 *
 * @param  bufid  Unused parameter, required by ZBOSS scheduler API.
 */
static void toggle_identify_led(zb_bufid_t bufid)
{
	static int blink_status;

	dk_set_led(IDENTIFY_LED, (++blink_status) % 2);
	ZB_SCHEDULE_APP_ALARM(toggle_identify_led, bufid, ZB_MILLISECONDS_TO_BEACON_INTERVAL(100));
}

/**@brief Function to handle identify notification events on the endpoint.
 *
 * @param  bufid  Unused parameter, required by ZBOSS scheduler API.
 */
static void identify_cb(zb_bufid_t bufid)
{
	zb_ret_t zb_err_code;

	if (bufid) {
		/* Schedule a self-scheduling function that will toggle the LED */
		ZB_SCHEDULE_APP_CALLBACK(toggle_identify_led, bufid);
	} else {
		/* Cancel the toggling function alarm and turn off LED */
		zb_err_code = ZB_SCHEDULE_APP_ALARM_CANCEL(toggle_identify_led, ZB_ALARM_ANY_PARAM);
		ZVUNUSED(zb_err_code);

		dk_set_led(IDENTIFY_LED, 0);
	}
}

/**@brief Starts identifying the device.
 *
 * @param  bufid  Unused parameter, required by ZBOSS scheduler API.
 */
static void start_identifying(zb_bufid_t bufid)
{
	ZVUNUSED(bufid);

	if (ZB_JOINED()) {
		if (dev_ctx.identify_attr.identify_time ==
		ZB_ZCL_IDENTIFY_IDENTIFY_TIME_DEFAULT_VALUE) {

			zb_ret_t zb_err_code = zb_bdb_finding_binding_target(
				SENSOR_ENDPOINT);

			if (zb_err_code == RET_OK) {
				LOG_INF("Enter identify mode");
			} else if (zb_err_code == RET_INVALID_STATE) {
				LOG_WRN("RET_INVALID_STATE - Cannot enter identify mode");
			} else {
				ZB_ERROR_CHECK(zb_err_code);
			}
		} else {
			LOG_INF("Cancel identify mode");
			zb_bdb_finding_binding_target_cancel();
		}
	} else {
		LOG_WRN("Device not in a network - cannot enter identify mode");
	}
}

/**@brief Callback for button events.
 *
 * Button 1's simulation job is done — the sensor owns occupancy
 * now. Button 4 keeps its Chapter 6 duties (identify / reset).
 */
static void button_changed(uint32_t button_state, uint32_t has_changed)
{
	if (IDENTIFY_MODE_BUTTON & has_changed) {
		if (IDENTIFY_MODE_BUTTON & button_state) {
			/* Button changed its state to pressed */
		} else {
			/* Button changed its state to released */
			if (was_factory_reset_done()) {
				/* The long press was for Factory Reset */
				LOG_DBG("After Factory Reset - ignore button release");
			} else   {
				/* Button released before Factory Reset */

				/* Start identification mode */
				ZB_SCHEDULE_APP_CALLBACK(start_identifying, 0);
			}
		}
	}

	check_factory_reset_button(button_state, has_changed);
}

/**@brief Function for initializing LEDs and Buttons. */
static void configure_gpio(void)
{
	int err;

	err = dk_buttons_init(button_changed);
	if (err) {
		LOG_ERR("Cannot init buttons (err: %d)", err);
	}

	err = dk_leds_init();
	if (err) {
		LOG_ERR("Cannot init LEDs (err: %d)", err);
	}
}

/**@brief Zigbee stack event handler — Chapter 6's, unchanged. */
void zboss_signal_handler(zb_bufid_t bufid)
{
	/* Update network status LED. */
	zigbee_led_status_update(bufid, ZIGBEE_NETWORK_STATE_LED);

	/* No application-specific behavior is required.
	 * Call default signal handler.
	 */
	ZB_ERROR_CHECK(zigbee_default_signal_handler(bufid));

	/* All callbacks should either reuse or free passed buffers.
	 * If bufid == 0, the buffer is invalid (not passed).
	 */
	if (bufid) {
		zb_buf_free(bufid);
	}
}

int main(void)
{
	LOG_INF("Starting Zigbee, Engineered - occupancy endpoint (LD2410-driven)");

	/* Initialize */
	configure_gpio();
	register_factory_reset_button(FACTORY_RESET_BUTTON);

	/* Register device context (endpoints). */
	ZB_AF_REGISTER_DEVICE_CTX(&sensor_ctx);

	app_clusters_attr_init();

	/* Register handlers to identify notifications */
	ZB_AF_SET_IDENTIFY_NOTIFICATION_HANDLER(SENSOR_ENDPOINT, identify_cb);

	/* Start Chapter 4's driver on uart1 — the same call, the
	 * same contract as in its own chapter. A failed start is
	 * loud but not fatal to the Zigbee side: the endpoint still
	 * joins and answers (with a permanently unoccupied
	 * attribute), and the log says exactly why.
	 */
	k_work_init(&publish_work, publish_handler);

	int err = ld2410_start(sensor_uart, on_reading, NULL);

	if (err != 0) {
		LOG_ERR("LD2410 driver failed to start (%d) - "
			"endpoint will report UNOCCUPIED; check the overlay/wiring",
			err);
	}

	/* Start Zigbee default thread */
	zigbee_enable();

	LOG_INF("Endpoint 10 live: Occupancy follows the LD2410. "
		"Walk in, walk out, read 0x0406/0x0000 from the coordinator");

	return 0;
}
```

## include/zb_occupancy_sensor.h
```c
/*
 * Chapter 7 — the Occupancy Sensor device declaration.
 *
 * ZBOSS (as shipped in the Zigbee R23 add-on) defines the Occupancy
 * Sensing CLUSTER (zb_zcl_occupancy_sensing.h) but no ready-made
 * Occupancy Sensor DEVICE declaration — so, exactly as Chapter 6
 * vendored the range extender's declaration, the course declares
 * its own device from the stack's cluster macros. Nothing here is
 * invented API: every macro below is the same ZB_ZCL_CLUSTER_DESC /
 * ZB_AF_DECLARE_ENDPOINT_DESC machinery the add-on's own device
 * headers (zb_ha_dimmable_light.h, zb_range_extender.h) use.
 *
 * The device: an HA-profile Occupancy Sensor, device ID 0x0107
 * (ZCL device table, Lighting & Occupancy category). One endpoint,
 * three server clusters:
 *
 *   Basic (0x0000)              — identity, as always
 *   Identify (0x0003)           — "which desk is it?" blinking
 *   Occupancy Sensing (0x0406)  — the product: Chapter 7's subject
 *
 * Chapter 8 Step 1 carries a copy of this header whose only change
 * is a reporting context (ZB_OCCUPANCY_SENSOR_REPORT_ATTR_COUNT 1);
 * Chapter 8 Step 2's copy adds the On/Off CLIENT cluster. Watch the
 * header grow; the endpoint's story is the course's story.
 */

#ifndef ZB_OCCUPANCY_SENSOR_H
#define ZB_OCCUPANCY_SENSOR_H 1

/**
 *  @defgroup ZB_DEFINE_DEVICE_OCCUPANCY_SENSOR Occupancy Sensor
 *  @{
 *  @details
 *      - @ref ZB_ZCL_BASIC \n
 *      - @ref ZB_ZCL_IDENTIFY \n
 *      - @ref ZB_ZCL_OCCUPANCY_SENSING
 */

/** Occupancy Sensor Device ID (HA profile, ZCL device table) */
#define ZB_OCCUPANCY_SENSOR_DEVICE_ID 0x0107

/** Occupancy sensor device version */
#define ZB_DEVICE_VER_OCCUPANCY_SENSOR 0

/** @cond internals_doc */

/** Occupancy sensor IN (server) clusters number */
#define ZB_OCCUPANCY_SENSOR_IN_CLUSTER_NUM 3

/** Occupancy sensor OUT (client) clusters number */
#define ZB_OCCUPANCY_SENSOR_OUT_CLUSTER_NUM 0

#define ZB_OCCUPANCY_SENSOR_CLUSTER_NUM \
	(ZB_OCCUPANCY_SENSOR_IN_CLUSTER_NUM + ZB_OCCUPANCY_SENSOR_OUT_CLUSTER_NUM)

/** Number of attributes for reporting on Occupancy sensor device.
 * Chapter 7 does not report yet (Chapter 8, Step 1 turns this on).
 */
#define ZB_OCCUPANCY_SENSOR_REPORT_ATTR_COUNT 0

/** @endcond */ /* internals_doc */

/**
 * @brief Declare cluster list for Occupancy sensor device
 * @param cluster_list_name - cluster list variable name
 * @param basic_attr_list - attribute list for Basic cluster
 * @param identify_attr_list - attribute list for Identify cluster
 * @param occupancy_attr_list - attribute list for Occupancy Sensing cluster
 */
#define ZB_DECLARE_OCCUPANCY_SENSOR_CLUSTER_LIST(			      \
		cluster_list_name,					      \
		basic_attr_list,					      \
		identify_attr_list,					      \
		occupancy_attr_list)					      \
zb_zcl_cluster_desc_t cluster_list_name[] =				      \
{									      \
	ZB_ZCL_CLUSTER_DESC(						      \
		ZB_ZCL_CLUSTER_ID_BASIC,				      \
		ZB_ZCL_ARRAY_SIZE(basic_attr_list, zb_zcl_attr_t),	      \
		(basic_attr_list),					      \
		ZB_ZCL_CLUSTER_SERVER_ROLE,				      \
		ZB_ZCL_MANUF_CODE_INVALID				      \
	),								      \
	ZB_ZCL_CLUSTER_DESC(						      \
		ZB_ZCL_CLUSTER_ID_IDENTIFY,				      \
		ZB_ZCL_ARRAY_SIZE(identify_attr_list, zb_zcl_attr_t),	      \
		(identify_attr_list),					      \
		ZB_ZCL_CLUSTER_SERVER_ROLE,				      \
		ZB_ZCL_MANUF_CODE_INVALID				      \
	),								      \
	ZB_ZCL_CLUSTER_DESC(						      \
		ZB_ZCL_CLUSTER_ID_OCCUPANCY_SENSING,			      \
		ZB_ZCL_ARRAY_SIZE(occupancy_attr_list, zb_zcl_attr_t),	      \
		(occupancy_attr_list),					      \
		ZB_ZCL_CLUSTER_SERVER_ROLE,				      \
		ZB_ZCL_MANUF_CODE_INVALID				      \
	)								      \
}

/** @cond internals_doc */

/**
 * @brief Declare simple descriptor for Occupancy sensor device
 * @param ep_name - endpoint variable name
 * @param ep_id - endpoint ID
 * @param in_clust_num - number of supported input clusters
 * @param out_clust_num - number of supported output clusters
 */
#define ZB_ZCL_DECLARE_OCCUPANCY_SENSOR_SIMPLE_DESC(ep_name, ep_id, in_clust_num, out_clust_num) \
	ZB_DECLARE_SIMPLE_DESC(in_clust_num, out_clust_num);				       \
	ZB_AF_SIMPLE_DESC_TYPE(in_clust_num, out_clust_num) simple_desc_##ep_name =	       \
	{										       \
		ep_id,									       \
		ZB_AF_HA_PROFILE_ID,							       \
		ZB_OCCUPANCY_SENSOR_DEVICE_ID,						       \
		ZB_DEVICE_VER_OCCUPANCY_SENSOR,						       \
		0,									       \
		in_clust_num,								       \
		out_clust_num,								       \
		{									       \
			ZB_ZCL_CLUSTER_ID_BASIC,					       \
			ZB_ZCL_CLUSTER_ID_IDENTIFY,					       \
			ZB_ZCL_CLUSTER_ID_OCCUPANCY_SENSING				       \
		}									       \
	}

/** @endcond */

/**
 * @brief Declare endpoint for Occupancy sensor device
 * @param ep_name - endpoint variable name
 * @param ep_id - endpoint ID
 * @param cluster_list - endpoint cluster list
 */
#define ZB_DECLARE_OCCUPANCY_SENSOR_EP(ep_name, ep_id, cluster_list)			      \
	ZB_ZCL_DECLARE_OCCUPANCY_SENSOR_SIMPLE_DESC(ep_name, ep_id,			      \
		ZB_OCCUPANCY_SENSOR_IN_CLUSTER_NUM, ZB_OCCUPANCY_SENSOR_OUT_CLUSTER_NUM);     \
	ZB_AF_DECLARE_ENDPOINT_DESC(ep_name, ep_id, ZB_AF_HA_PROFILE_ID, 0, NULL,	      \
		ZB_ZCL_ARRAY_SIZE(cluster_list, zb_zcl_cluster_desc_t), cluster_list,	      \
			(zb_af_simple_desc_1_1_t *)&simple_desc_##ep_name,		      \
			0, NULL, /* No reporting ctx — Chapter 8, Step 1 */		      \
			0, NULL) /* No CVC ctx */

/*! @} */

#endif /* ZB_OCCUPANCY_SENSOR_H */
```
